#include "lcd_st77922.h"
#include <Arduino.h>
#include <string.h>
#include <driver/spi_master.h>
#include <esp_heap_caps.h>
#include "app_config.h"

#define OP_WRITE_CMD   0x02
#define OP_WRITE_COLOR 0x32

typedef struct {
  uint8_t cmd;
  const uint8_t *data;
  uint8_t len;
  uint16_t delay_ms;
} init_cmd_t;

#define D(...) (const uint8_t[]){__VA_ARGS__}

// Vendor init sequence for the ES3C35P panel (LCDwiki Example_01_Simple_test).
// The panel stays black without it.
static const init_cmd_t k_init[] = {
  {0xF1, D(0x00), 1, 0},
  {0x60, D(0x00, 0x00, 0x00), 3, 0},
  {0x65, D(0x80), 1, 0},
  {0x79, D(0x06), 1, 0},
  {0x7B, D(0x00, 0x08, 0x08), 3, 0},
  {0x80, D(0x55, 0x62, 0x2F, 0x17, 0xF0, 0x52, 0x70, 0xD2, 0x52, 0x62, 0xEA), 11, 0},
  {0x81, D(0x26, 0x52, 0x72, 0x27), 4, 0},
  {0x84, D(0x92, 0x25), 2, 0},
  {0x87, D(0x10, 0x10, 0x58, 0x00, 0x02, 0x3A), 6, 0},
  {0x88, D(0x00, 0x00, 0x2C, 0x10, 0x04, 0x00, 0x00, 0x00, 0x01, 0x01, 0x01, 0x01, 0x01, 0x00, 0x06), 15, 0},
  {0x89, D(0x00, 0x00, 0x00), 3, 0},
  {0x8A, D(0x13, 0x00, 0x2C, 0x00, 0x00, 0x2C, 0x10, 0x10, 0x00, 0x3E, 0x19), 11, 0},
  {0x8B, D(0x15, 0xB1, 0xB1, 0x44, 0x96, 0x2C, 0x10, 0x97, 0x8E), 9, 0},
  {0x8C, D(0x1D, 0xB1, 0xB1, 0x44, 0x96, 0x2C, 0x10, 0x50, 0x0F, 0x01, 0xC5, 0x12, 0x09), 13, 0},
  {0x8D, D(0x0C), 1, 0},
  {0x8E, D(0x33, 0x01, 0x0C, 0x13, 0x01, 0x01), 6, 0},
  {0xB3, D(0x00, 0x30), 2, 0},
  {0xF1, D(0x00), 1, 0},
  {0x71, D(0xD0), 1, 0},
  {0x66, D(0x02, 0x3F), 2, 0},
  {0xBE, D(0x26, 0x00, 0x9D), 3, 0},
  {0x70, D(0x01, 0xA0, 0x11, 0x40, 0xE0, 0x00, 0x11, 0x69, 0x11, 0x00, 0x00, 0x1A), 12, 0},
  {0x90, D(0x04, 0x04, 0x55, 0x74, 0x00, 0x40, 0x43, 0x27, 0x27), 9, 0},
  {0x91, D(0x04, 0x04, 0x55, 0x75, 0x00, 0x40, 0x42, 0x27, 0x27), 9, 0},
  {0x92, D(0x04, 0x44, 0x55, 0xC0, 0x06, 0x00, 0x07, 0x05, 0x90, 0x27), 10, 0},
  {0x93, D(0x04, 0x43, 0x11, 0x00, 0x00, 0x00, 0x00, 0x05, 0x90, 0x27), 10, 0},
  {0x94, D(0x00, 0x00, 0x00, 0x00, 0x00, 0x00), 6, 0},
  {0x95, D(0x96, 0x16, 0x00, 0x00, 0xFF), 5, 0},
  {0x96, D(0x44, 0x53, 0x03, 0x12, 0x23, 0x24, 0x06, 0x05, 0x94, 0x27, 0x00, 0x44), 12, 0},
  {0x97, D(0x44, 0x53, 0x47, 0x56, 0x20, 0x20, 0x02, 0x01, 0x94, 0x27, 0x00, 0x44), 12, 0},
  {0xBA, D(0x55, 0x94, 0x2D, 0x94, 0x27), 5, 0},
  {0x9A, D(0x40, 0x00, 0x06, 0x00, 0x00, 0x00, 0x00), 7, 0},
  {0x9B, D(0x00, 0x00, 0x06, 0x00, 0x00, 0x00, 0x00), 7, 0},
  {0x9C, D(0x5C, 0x12, 0x00, 0x00, 0x10, 0x12, 0x00, 0x00, 0x10, 0x02, 0x00, 0x00, 0x00), 13, 0},
  {0x9D, D(0x8A, 0x51, 0x00, 0x00, 0x00, 0x80, 0x1E, 0x01), 8, 0},
  {0x9E, D(0x51, 0x00, 0x00, 0x00, 0x80, 0x1E, 0x01), 7, 0},
  {0xB4, D(0x1D, 0x1C, 0x1E, 0x0B, 0x14, 0x02, 0x13, 0x09, 0x1E, 0x00, 0x1E, 0x10), 12, 0},
  {0xB5, D(0x1D, 0x1C, 0x1E, 0x0A, 0x15, 0x03, 0x11, 0x08, 0x1E, 0x01, 0x1E, 0x12), 12, 0},
  {0xB6, D(0x77, 0x77, 0x00, 0x0A, 0xFF, 0x0A, 0xFF), 7, 0},
  {0x86, D(0xCD, 0x04, 0xB1, 0x02, 0x58, 0x12, 0x58, 0x0C, 0x13, 0x01, 0xA5, 0x00, 0xA5, 0xA5), 14, 0},
  {0xB7, D(0x07, 0x0A, 0x0E, 0x06, 0x05, 0x03, 0x2B, 0x03, 0x03, 0x42, 0x07, 0x10, 0x10, 0x2E, 0x3F, 0x0D), 16, 0},
  {0xB8, D(0x07, 0x0A, 0x0D, 0x05, 0x05, 0x02, 0x2B, 0x02, 0x03, 0x42, 0x06, 0x10, 0x0F, 0x2E, 0x3F, 0x0D), 16, 0},
  {0xB9, D(0x23, 0x23), 2, 0},
  {0xBF, D(0x10, 0x14, 0x14, 0x0B, 0x0B, 0x0B), 6, 0},
  {0xF2, D(0x00), 1, 0},
  {0x73, D(0x04, 0xDA, 0x12, 0x54, 0x47), 5, 0},
  {0x77, D(0x6B, 0x5B, 0xFD, 0xC3, 0xC5), 5, 0},
  {0x7A, D(0x15, 0x27), 2, 0},
  {0x7B, D(0x04, 0x57), 2, 0},
  {0x7E, D(0x01, 0x0E), 2, 0},
  {0xBF, D(0x36), 1, 0},
  {0xE3, D(0x40, 0x40), 2, 0},
  {0xF0, D(0x00), 1, 0},
  {0xD0, D(0x00), 1, 0},
  {0x2A, D(0x00, 0x00, 0x01, 0x3F), 4, 0},
  {0x2B, D(0x00, 0x00, 0x01, 0xDF), 4, 0},
  {0x21, nullptr, 0, 0},     // INVON (panel needs inverted data)
  {0x11, nullptr, 0, 120},   // SLPOUT
  {0x29, nullptr, 0, 0},     // DISPON
  {0x2C, nullptr, 0, 0},
  {0x3A, D(0x01), 1, 0},     // COLMOD as the vendor sets it (renders RGB565)
  {0x36, D(0x00), 1, 0},
  {0x35, D(0x01), 1, 20},    // TEON
};

static spi_device_handle_t s_dev;
static uint16_t *s_bounce;  // internal DMA buffer, LCD_CHUNK_BYTES
alignas(4) static uint8_t s_param[32];  // RAM copy of command params (longest init entry is 16 bytes)

// Must match the vendor framing exactly: per-transaction cmd/addr widths and params sent from a
// RAM buffer. Device-level widths + SPI_TRANS_USE_TXDATA leave the panel black after a hard reset.
static void write_cmd(uint8_t cmd, const uint8_t *data, size_t len) {
  spi_transaction_ext_t e;
  memset(&e, 0, sizeof(e));
  e.base.flags = SPI_TRANS_VARIABLE_CMD | SPI_TRANS_VARIABLE_ADDR;
  e.command_bits = 8;
  e.address_bits = 24;
  e.base.cmd = OP_WRITE_CMD;
  e.base.addr = (uint32_t)cmd << 8;
  e.base.length = len * 8;
  if (len) { memcpy(s_param, data, len); e.base.tx_buffer = s_param; }
  spi_device_polling_transmit(s_dev, (spi_transaction_t *)&e);
}

static void set_window(int x1, int y1, int x2, int y2) {
  const uint8_t ca[4] = {(uint8_t)(x1 >> 8), (uint8_t)x1, (uint8_t)(x2 >> 8), (uint8_t)x2};
  const uint8_t ra[4] = {(uint8_t)(y1 >> 8), (uint8_t)y1, (uint8_t)(y2 >> 8), (uint8_t)y2};
  write_cmd(0x2A, ca, 4);
  write_cmd(0x2B, ra, 4);
}

static void write_pixels(const uint16_t *px, size_t bytes) {
  spi_transaction_ext_t e;
  memset(&e, 0, sizeof(e));
  e.base.flags = SPI_TRANS_MODE_QIO | SPI_TRANS_VARIABLE_CMD | SPI_TRANS_VARIABLE_ADDR;  // data on 4 lines
  e.command_bits = 8;
  e.address_bits = 24;
  e.base.cmd = OP_WRITE_COLOR;
  e.base.addr = 0x3C << 8;  // RAMWRC, as the vendor driver does (RAMWR 0x2C leaves the panel black)
  e.base.length = bytes * 8;
  e.base.tx_buffer = px;
  spi_device_polling_transmit(s_dev, (spi_transaction_t *)&e);
}

bool lcd_init() {
  s_bounce = (uint16_t *)heap_caps_malloc(LCD_CHUNK_BYTES, MALLOC_CAP_DMA | MALLOC_CAP_INTERNAL);
  if (!s_bounce) return false;

  spi_bus_config_t bus = {};
  bus.data0_io_num = LCD_PIN_D0;
  bus.data1_io_num = LCD_PIN_D1;
  bus.data2_io_num = LCD_PIN_D2;
  bus.data3_io_num = LCD_PIN_D3;
  bus.sclk_io_num = LCD_PIN_SCK;
  bus.max_transfer_sz = LCD_CHUNK_BYTES;
  bus.flags = SPICOMMON_BUSFLAG_MASTER | SPICOMMON_BUSFLAG_IOMUX_PINS | SPICOMMON_BUSFLAG_QUAD;
  if (spi_bus_initialize(SPI2_HOST, &bus, SPI_DMA_CH_AUTO) != ESP_OK) return false;

  // Command/address widths are set per transaction (see write_cmd)
  spi_device_interface_config_t dev = {};
  dev.mode = 0;
  dev.clock_speed_hz = LCD_SPI_HZ;
  dev.spics_io_num = LCD_PIN_CS;
  dev.queue_size = 1;
  dev.flags = SPI_DEVICE_HALFDUPLEX;
  if (spi_bus_add_device(SPI2_HOST, &dev, &s_dev) != ESP_OK) return false;

  for (const init_cmd_t &c : k_init) {
    write_cmd(c.cmd, c.data, c.len);
    if (c.delay_ms) delay(c.delay_ms);
  }
  const uint8_t madctl = LCD_MADCTL;
  write_cmd(0x36, &madctl, 1);
  return true;
}

void lcd_draw(int x1, int y1, int x2, int y2, const uint16_t *px, int stride_px) {
  const int w = x2 - x1 + 1;
  int rows_per_chunk = (LCD_CHUNK_BYTES / 2) / w;
  if (rows_per_chunk < 1) rows_per_chunk = 1;

  for (int y = y1; y <= y2; y += rows_per_chunk) {
    const int rows = min(rows_per_chunk, y2 - y + 1);
    // Copy into the DMA bounce buffer, swapping to big-endian RGB565
    uint16_t *dst = s_bounce;
    for (int r = 0; r < rows; r++) {
      const uint16_t *src = px + (size_t)(y - y1 + r) * stride_px;
      for (int i = 0; i < w; i++) {
        const uint16_t c = src[i];
        *dst++ = (c >> 8) | (c << 8);
      }
    }
    set_window(x1, y, x2, y + rows - 1);
    write_pixels(s_bounce, (size_t)w * rows * 2);
  }
}
